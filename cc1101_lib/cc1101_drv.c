/***********************************************************************************
    Filename: cc1101_drv.c

    Платформенно-зависимые функции.

    (с) Онищенко Денис, март 2013, v 1.0
***********************************************************************************/

#include "cc1101_drv.h"

// Перезапуск радиомодуля при включении
void rf_pwr_on_reset(void)
{
    RF_CS_ON;
    delay(100); // задержка, платформенно зависимая. нужно 10мс
    RF_CS_OFF;
    delay(500); // нужно не менее 40 мс, ставлю 50 мс
}

// Функция обмена по SPI, без прерываний
uint8_t rf_exchange(uint8_t snd_byte)
{ // Сюда вставить конкретную функцию обмена по
    unsigned char data; // SPI для данного процессора
    __disable_interrupt(); // Отключаем прерывания
    S0SPDR = snd_byte;
    while (!(S0SPSR & 0x80))
        ;
    data = S0SPDR;
    delay(5);
    __enable_interrupt();
    return data;
}

// Функция ожидания низкого уровня на ножке MISO
RF_ERR rf_wait_ready(void)
{
    uint16_t cnt = 0; // счетчик
    while (cnt < 0xFFFE) { // таймаут в циклах. Может быть недостаточен
        cnt++; // или избыточен для некоторых исполнений
        if (!RF_nRDY) // радиомодуль готов
            break;
    }
    if (cnt < 0xFFFE)
        return RF_OK;
    else
        return RF_ERR_NOT_READY;
}
